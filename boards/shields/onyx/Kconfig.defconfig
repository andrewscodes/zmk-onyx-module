## boards/shields/onyx/Kconfig.defconfig
```kconfig
if SHIELD_ONYX_LEFT

config ZMK_KEYBOARD_NAME
    default "Onyx"

config ZMK_SPLIT_ROLE_CENTRAL
    default y

endif

if SHIELD_ONYX_LEFT || SHIELD_ONYX_RIGHT

config ZMK_SPLIT
    default y

if ZMK_RGB_UNDERGLOW

config WS2812_STRIP
    default y
endif

endif
```
